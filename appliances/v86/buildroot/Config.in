## appliances/v86/buildroot/Config.in
```kconfig
# The host-only anycast-clang-toolchain package is an explicit build dependency
# from external.mk and intentionally has no user-selectable target option.
source "$BR2_EXTERNAL_ANYCAST_LAB_PATH/package/anycast-labd/Config.in"
```

## appliances/v86/buildroot/configs/anycast_lab_v86_defconfig
```kconfig
BR2_x86_pentiumpro=y
BR2_TOOLCHAIN_BUILDROOT_GLIBC=y
BR2_PIC_PIE=y
BR2_RELRO_FULL=y
BR2_ENABLE_LOCALE_PURGE=y
BR2_ENABLE_LOCALE_WHITELIST="C"
BR2_GENERATE_LOCALE=""
BR2_PACKAGE_HOST_LINUX_HEADERS_CUSTOM_6_18=y
BR2_CCACHE=y
BR2_CCACHE_INITIAL_SETUP="--max-size=3G"
BR2_CCACHE_USE_BASEDIR=y
BR2_GLOBAL_PATCH_DIR="board/qemu/patches $(BR2_EXTERNAL_ANYCAST_LAB_PATH)/patches"
BR2_DOWNLOAD_FORCE_CHECK_HASHES=y
BR2_REPRODUCIBLE=y
BR2_TARGET_GENERIC_HOSTNAME="anycastlab"
BR2_TARGET_GENERIC_ISSUE="Anycast Lab router appliance"
# The production root is an immutable SquashFS; writable per-node state lives
# on namespace-local tmpfs/overlay mounts prepared by the shared supervisor.
# BR2_TARGET_GENERIC_REMOUNT_ROOTFS_RW is not set
# Browser terminals are namespace-local PTYs created by anycast-labd; the
# shared host namespace deliberately has no login/getty process.
# BR2_TARGET_GENERIC_GETTY is not set
BR2_SYSTEM_DHCP=""
BR2_ROOTFS_OVERLAY="$(BR2_EXTERNAL_ANYCAST_LAB_PATH)/board/rootfs-overlay"
BR2_ROOTFS_POST_BUILD_SCRIPT="$(BR2_EXTERNAL_ANYCAST_LAB_PATH)/board/post-build.sh"
BR2_ROOTFS_POST_FAKEROOT_SCRIPT="$(BR2_EXTERNAL_ANYCAST_LAB_PATH)/board/post-fakeroot.sh"
BR2_LINUX_KERNEL=y
BR2_LINUX_KERNEL_CUSTOM_VERSION=y
BR2_LINUX_KERNEL_CUSTOM_VERSION_VALUE="6.18.7"
BR2_LINUX_KERNEL_USE_CUSTOM_CONFIG=y
BR2_LINUX_KERNEL_CUSTOM_CONFIG_FILE="$(BR2_EXTERNAL_ANYCAST_LAB_PATH)/board/linux.config"
BR2_LINUX_KERNEL_NEEDS_HOST_LIBELF=y
# The browser attaches rootfs-complete.squashfs as the first IDE disk and the
# kernel mounts it directly. Do not duplicate the full userspace in bzImage.
# BR2_TARGET_ROOTFS_INITRAMFS is not set
# BR2_TARGET_ROOTFS_CPIO is not set
# BR2_TARGET_ROOTFS_TAR is not set
BR2_PACKAGE_BUSYBOX_CONFIG="$(BR2_EXTERNAL_ANYCAST_LAB_PATH)/board/busybox-shared.config"
# BR2_PACKAGE_BUSYBOX_INDIVIDUAL_BINARIES is not set
# BR2_PACKAGE_IFUPDOWN_SCRIPTS is not set
# BR2_PACKAGE_URANDOM_SCRIPTS is not set
BR2_PACKAGE_IPROUTE2=y
# BusyBox supplies non-SUID ping/ping6; the standalone iputils permission table
# otherwise makes ping and clockdiff setuid when rootfs xattrs are unavailable.
# BR2_PACKAGE_IPUTILS is not set
BR2_PACKAGE_TRACEROUTE=y
BR2_PACKAGE_TCPDUMP=y
# BR2_PACKAGE_ETHTOOL is not set
BR2_PACKAGE_BIRD=y
BR2_PACKAGE_BIRD_CLIENT=y
BR2_PACKAGE_BIRD_BABEL=y
BR2_PACKAGE_BIRD_BFD=y
BR2_PACKAGE_BIRD_BGP=y
BR2_PACKAGE_BIRD_MRT=y
BR2_PACKAGE_BIRD_OSPF=y
BR2_PACKAGE_BIRD_PIPE=y
BR2_PACKAGE_BIRD_RADV=y
BR2_PACKAGE_BIRD_RIP=y
BR2_PACKAGE_BIRD_RPKI=y
BR2_PACKAGE_BIRD_STATIC=y
# FRR's frrinit.sh/frrcommon.sh/watchfrr.sh use Bash syntax. Keep the runtime
# explicit even though the upstream FRR Kconfig currently selects it.
BR2_PACKAGE_BASH=y
BR2_PACKAGE_FRR=y
BR2_PACKAGE_FRR_BFD=y
# BR2_PACKAGE_FRR_PROTOBUF is not set
# Native nodes already provide an isolated appliance root. FRR stays on that
# identity, matching BIRD and the terminal, so the target does not need libcap.
# BR2_PACKAGE_LIBCAP is not set
BR2_PACKAGE_ANYCAST_LABD=y
# Target LLVM is intentionally absent. The external host-only suite compiles
# BIRD/FRR against this image's GCC/glibc sysroot without entering the rootfs.
# BR2_PACKAGE_LLVM is not set
# BR2_PACKAGE_CLANG is not set
# BR2_PACKAGE_COMPILER_RT is not set
```

## appliances/v86/buildroot/package/anycast-labd/Config.in
```kconfig
config BR2_PACKAGE_ANYCAST_LABD
	bool "anycast-labd"
	depends on BR2_USE_MMU
	select BR2_PACKAGE_IPROUTE2
	help
	  Shared-kernel native lab supervisor. It creates isolated router/client
	  namespaces, per-node overlay roots and VLAN interfaces, then exposes the
	  bounded ANYCASTLAB/2 control protocol over the virtio console.
```
